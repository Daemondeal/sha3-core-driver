## LedExampleProject/LedPynq/project-spec/configs/rootfsconfigs/Kconfig.user
```kconfig
menu "user packages " 
config gpio-demo  
	 bool "gpio-demo"
	 help
	
config ledmodule  
	 bool "ledmodule"
	 help
	
config peekpoke  
	 bool "peekpoke"
	 help
	
config sharutils  
	 bool "sharutils"
	 help
	
endmenu
```

## Petalinux/ketchup_driver/project-spec/configs/rootfsconfigs/Kconfig.user
```kconfig
menu "user packages " 
config gpio-demo  
	 bool "gpio-demo"
	 help
	
config ketchup-driver  
	 bool "ketchup-driver"
	 help
	
config peekpoke  
	 bool "peekpoke"
	 help
	
config sharutils  
	 bool "sharutils"
	 help
	
endmenu
```
